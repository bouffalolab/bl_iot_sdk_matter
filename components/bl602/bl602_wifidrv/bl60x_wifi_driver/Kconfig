## components/bl602/bl602_wifidrv/bl60x_wifi_driver/Kconfig
```kconfig
menu "BL606A0 Wi-Fi Config"
    config BL606A0_WIFI_FULLMAC
        bool "Enable BL606A0 Wi-Fi Support (FullMAC)"
            default false
endmenu
```
